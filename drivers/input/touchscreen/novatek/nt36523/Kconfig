## drivers/input/touchscreen/novatek/nt36523/Kconfig
```kconfig
#
# Novatek NT36xxx touchscreen driver configuration
#
config TOUCHSCREEN_NOVATEK_NT36523
	bool "Novatek NT36523"
	depends on I2C
	select INPUT_SEC_INPUT_V2
	help
	  Say Y here if you have a Novatek NT36523 touchscreen connected
	  to your system.

	  If unsure, say N.
```
